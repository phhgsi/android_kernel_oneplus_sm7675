## arch/arm64/configs/avalon_defconfig
```kconfig
CONFIG_INTERCONNECT=y
CONFIG_ARCH_QCOM=y
CONFIG_NETDEVICES=y
CONFIG_CAN_DEV=y
CONFIG_CAN_NETLINK=y
CONFIG_GKI_HIDDEN_QCOM_CONFIGS=y
CONFIG_GKI_HIDDEN_MCP251XFD_CONFIGS=y
CONFIG_ARM64=y
CONFIG_ARCH_SUPPORTS_MEMORY_FAILURE=y
CONFIG_ARM64_PTR_AUTH=y
CONFIG_ARM64_PTR_AUTH_KERNEL=y
CONFIG_ARM64_AMU_EXTN=y
CONFIG_ARM64_TLB_RANGE=y
CONFIG_ARM64_BTI=y
CONFIG_ARM64_E0PD=y
CONFIG_ARM64_MTE=y
CONFIG_RANDSTRUCT_FULL=y
CONFIG_STACKPROTECTOR=y
CONFIG_STACKPROTECTOR_STRONG=y
CONFIG_SECCOMP=y
CONFIG_JUMP_LABEL=y
CONFIG_SHADOW_CALL_STACK=y
CONFIG_INIT_STACK_ALL_ZERO=y
CONFIG_INIT_ON_ALLOC_DEFAULT_ON=n
CONFIG_INIT_ON_FREE_DEFAULT_ON=n
CONFIG_ZERO_CALL_USED_REGS=n
CONFIG_KCOV=y
CONFIG_MEMTEST=n
CONFIG_ARCH_MMAP_RND_BITS=18
CONFIG_ARCH_MMAP_RND_COMPAT_BITS=11
CONFIG_RANDOMIZE_KSTACK_OFFSET=y
CONFIG_RANDOMIZE_KSTACK_OFFSET_DEFAULT=n
CONFIG_COMPAT_32BIT_TIME=y
```
